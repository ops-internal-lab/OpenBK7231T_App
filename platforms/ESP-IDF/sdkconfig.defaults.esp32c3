## platforms/ESP-IDF/sdkconfig.defaults.esp32c3
```kconfig
CONFIG_PM_ENABLE=y
CONFIG_PM_DFS_INIT_AUTO=y
CONFIG_ESP_DEFAULT_CPU_FREQ_MHZ_80=y
CONFIG_ESP_DEFAULT_CPU_FREQ_MHZ=80
CONFIG_PARTITION_TABLE_CUSTOM=y

# BLE / NimBLE for ESP32-C3
# The C3 uses NimBLE only (no Bluedroid - that's classic ESP32 only)
CONFIG_BT_ENABLED=y
CONFIG_BT_CONTROLLER_ENABLED=y
CONFIG_BT_NIMBLE_ENABLED=y
CONFIG_BT_NIMBLE_ROLE_CENTRAL=y
CONFIG_BT_NIMBLE_ROLE_PERIPHERAL=y
CONFIG_BT_NIMBLE_ROLE_BROADCASTER=y
CONFIG_BT_NIMBLE_ROLE_OBSERVER=y
CONFIG_BT_NIMBLE_MAX_CONNECTIONS=3
CONFIG_BT_NIMBLE_TASK_STACK_SIZE=4096

# BLE + WiFi coexistence - required on C3
CONFIG_ESP_COEX_ENABLED=y
CONFIG_ESP_COEX_SW_COEXIST_ENABLE=y

# Extra heap for BLE stack (BLE + WiFi together need more RAM)
CONFIG_ESP_MAIN_TASK_STACK_SIZE=5120
```
